## CMakeLists.txt
```
cmake_minimum_required(VERSION 3.20.0)
find_package(Zephyr REQUIRED HINTS $ENV{ZEPHYR_BASE})

project(Final_Test_1)

target_sources(app PRIVATE src/main.c)
```

## prj.conf
```kconfig
# Enable the core Bluetooth stack
CONFIG_BT=y

# Enable Bluetooth Peripheral role (for advertising)
CONFIG_BT_PERIPHERAL=y

# Enable Bluetooth Observer role (for scanning)
CONFIG_BT_OBSERVER=y

# Enable Bluetooth Host Controller Interface (HCI)
CONFIG_BT_HCI=y

# Enable the Bluetooth controller for Nordic Semiconductor
CONFIG_BT_LL_SW_SPLIT=y
CONFIG_BT_CTLR=y
CONFIG_BT_LLL_VENDOR_NORDIC=y

# Enable Extended Advertising support
CONFIG_BT_EXT_ADV=y

# Enable logging for debugging (optional but useful)
CONFIG_LOG=y
CONFIG_BT_DEBUG_LOG=y

# Adjust the main stack size if necessary
CONFIG_MAIN_STACK_SIZE=1024

# Enable additional Bluetooth features if necessary
CONFIG_BT_BROADCASTER=y
CONFIG_BT_SCAN_WITH_IDENTITY=y
```

## src/main.c
```c
#include <zephyr/types.h>
#include <stddef.h>
#include <zephyr/sys/printk.h>
#include <zephyr/sys/util.h>
#include <zephyr/bluetooth/bluetooth.h>
#include <zephyr/bluetooth/hci.h>
#include <zephyr/kernel.h>
#include <string.h>

static const char *device_name = "Iris6_Static"; // Fixed name for broadcasting

int main(void) {
    int err;
    
    printk("Starting Test 1: No Rotation (Broadcasting Only)\n");

    err = bt_enable(NULL);
    if (err) {
        printk("Bluetooth init failed (err %d)\n", err);
        return err;
    }

    printk("Bluetooth initialized\n");

    struct bt_data ad[] = {
        BT_DATA(BT_DATA_NAME_COMPLETE, device_name, strlen(device_name)),
    };

    err = bt_le_adv_start(BT_LE_ADV_NCONN, ad, ARRAY_SIZE(ad), NULL, 0);
    if (err) {
        printk("Advertising failed to start (err %d)\n", err);
        return err;
    }

    printk("Broadcasting with fixed name: %s\n", device_name);

    // The device broadcasts indefinitely without rotating the name
    while (1) {
        k_sleep(K_SECONDS(1));
    }

    return 0;
}
```
